## boards/shields/temper/Kconfig.defconfig
```kconfig
if SHIELD_TEMPER_DONGLE

config ZMK_KEYBOARD_NAME
	default "Temper Dongle"
	
config ZMK_SPLIT_ROLE_CENTRAL
	default y
	
endif

if SHIELD_TEMPER_LEFT || SHIELD_TEMPER_RIGHT || SHIELD_TEMPER_DONGLE

config ZMK_SPLIT
    default y

endif
```

## config/boards/shields/temper-dongle/Kconfig.defconfig
```kconfig
if SHIELD_TEMPER_DONGLE_DONGLE

config ZMK_KEYBOARD_NAME
	default "Temper Dongle"
	
config ZMK_SPLIT_ROLE_CENTRAL
	default y
	
endif

if SHIELD_TEMPER_DONGLE_LEFT || SHIELD_TEMPER_DONGLE_RIGHT || SHIELD_TEMPER_DONGLE_DONGLE

config ZMK_SPLIT
    default y

endif
```

## config/boards/shields/temper-dongle/Kconfig.shield
```kconfig
# Copyright (c) 2020 Pete Johanson
# SPDX-License-Identifier: MIT

config SHIELD_TEMPER_DONGLE_LEFT
    def_bool $(shields_list_contains,temper_dongle_left)

config SHIELD_TEMPER_DONGLE_RIGHT
    def_bool $(shields_list_contains,temper_dongle_right)

config SHIELD_TEMPER_DONGLE_DONGLE
    def_bool $(shields_list_contains,temper_dongle_dongle)
```
